/dts-v1/;
/plugin/;

/ {
    compatible = "rockchip,rk3229";

    fragment@0 {
        target = <&uart2>;
        status = "okay";
        __overlay__ {
            tvbox-gpio-serdev {
                compatible = "tvbox,tvbox-gpio-serdev";
                status = "okay";
            };
        };
    };
};

